## arch/arm/hotplug/Kconfig
```kconfig
config USES_MALI_MP2_GPU
	bool "Enable hotplugging feature for Mali GPUs"
	default n
	help
	  This option enables hotplugging features inside thunderplug 
	  for Mali 400MP2 GPUs.
```
